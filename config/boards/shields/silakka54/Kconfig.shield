## config/boards/shields/silakka54/Kconfig.shield
```kconfig
config SHIELD_SILAKKA54_LEFT
    def_bool $(shields_list_contains,silakka54_left)

config SHIELD_SILAKKA54_RIGHT
    def_bool $(shields_list_contains,silakka54_right)

config SHIELD_SILAKKA54_DONGLE_NOSD
    def_bool $(shields_list_contains,silakka54_dongle_nosd)
```

## module/Kconfig
```kconfig
config SILAKKA54_DONGLE_TOUCH
    bool "Silakka54 dongle bootloader touch"
    depends on ZMK_SPLIT && ZMK_SPLIT_ROLE_CENTRAL && USB_CDC_ACM && RETENTION_BOOT_MODE
    help
      Request UF2 bootloader entry when the dedicated dongle CDC ACM
      interface receives a 1200 baud line-coding change.
```
