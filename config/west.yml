## config/west.yml
```yaml
manifest:
  remotes:
    - name: zmkfirmware
      url-base: https://github.com/zmkfirmware
  projects:
    - name: zmk
      remote: zmkfirmware
      revision: ce8d9a36274478c3475b629466a4c7bdef07b2ed
      import: app/west.yml
  self:
    path: config
```
